#include <Arduino.h>
#include <Wire.h>
#include <math.h>
#include "display.h"

// ============================================================================
// U8g2 instance
// ============================================================================
#if defined(OLED_CHIP_SSD1306)
U8G2_SSD1306_128X64_NONAME_F_HW_I2C u8g2(U8G2_R0, /* reset=*/ U8X8_PIN_NONE);
#elif defined(OLED_CHIP_SH1106)
U8G2_SH1106_128X64_NONAME_F_HW_I2C u8g2(U8G2_R0, /* reset=*/ U8X8_PIN_NONE);
#endif

// ============================================================================
// 5x7 pixel font
// Ported directly from the verified simulator font (FONT_5x7 in
// DeskBuddyOLEDSimulator.jsx) - every glyph here was checked by rendering it
// as ASCII art and reading real words back before it was ever used, and this
// packed form was round-trip verified byte-for-byte against that source
// before being pasted in here. Do not hand-edit these bytes; regenerate from
// the JS source if a glyph needs to change.
//
// Each row byte uses bits 4..0 for columns 0..4 (bit4 = leftmost pixel).
// ============================================================================
static const char FONT_CHARSET[] PROGMEM = " ABCDEFGHIJKLMNOPQRSTUVWXYZ0123456789:%-/.";
#define FONT_CHAR_COUNT 42

static const uint8_t PIXEL_FONT[FONT_CHAR_COUNT][7] PROGMEM = {
  {0x00, 0x00, 0x00, 0x00, 0x00, 0x00, 0x00}, // ' '
  {0x0E, 0x11, 0x11, 0x1F, 0x11, 0x11, 0x11}, // 'A'
  {0x1E, 0x11, 0x11, 0x1E, 0x11, 0x11, 0x1E}, // 'B'
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  {0x00, 0x00, 0x00, 0x00, 0x00, 0x0C, 0x0C}, // '.'
};

// Degree sign, kept separate rather than in the char table above so weather
// code can draw it without needing UTF-8 handling in a plain char[] string.
static const uint8_t DEGREE_GLYPH[7] PROGMEM = {0x0C, 0x12, 0x0C, 0x00, 0x00, 0x00, 0x00};

static uint8_t charIndex(char c) {
  if (c >= 'a' && c <= 'z') c -= 32;
  for (uint8_t i = 0; i < FONT_CHAR_COUNT; i++) {
    if ((char)pgm_read_byte(&FONT_CHARSET[i]) == c) return i;
  }
  return 0; // space
}

enum TextAlign : uint8_t { ALIGN_LEFT, ALIGN_CENTER, ALIGN_RIGHT };

static void drawGlyphBytes(const uint8_t glyph[7], int16_t x, int16_t y, uint8_t cell) {
  for (uint8_t row = 0; row < 7; row++) {
    uint8_t rowBits = pgm_read_byte(&glyph[row]);
    for (uint8_t col = 0; col < 5; col++) {
      if (rowBits & (1 << (4 - col))) {
        u8g2.drawBox(x + col * cell, y + row * cell, cell, cell);
      }
    }
  }
}

// Direct port of drawPixelText() from the simulator. Returns total width in
// pixels (same as the JS version) in case a caller wants it for layout math.
static int16_t drawPixelText(const char* text, int16_t x, int16_t y, uint8_t cell, TextAlign align) {
  uint8_t len = strlen(text);
  int16_t totalWidth = (int16_t)len * 6 * cell - cell;
  int16_t startX = x;
  if (align == ALIGN_CENTER) startX = x - totalWidth / 2;
  else if (align == ALIGN_RIGHT) startX = x - totalWidth;

  u8g2.setDrawColor(1);
  int16_t cursor = startX;
  for (uint8_t i = 0; i < len; i++) {
    uint8_t idx = charIndex(text[i]);
    drawGlyphBytes(PIXEL_FONT[idx], cursor, y, cell);
    cursor += 6 * cell;
  }
  return totalWidth;
}

static void drawDegree(int16_t x, int16_t y, uint8_t cell) {
  u8g2.setDrawColor(1);
  drawGlyphBytes(DEGREE_GLYPH, x, y, cell);
}

// ============================================================================
// Idle-screen pet bitmap
// This is a real pixel extraction from the reference art (not a hand-drawn
// approximation) - the source PNG's blue channel was area-averaged down to
// 128x64 and thresholded to pure on/off, then the ear/head connection was
// hand-verified and patched row-by-row against the actual pixel data. This
// byte array was round-trip decoded and diffed against that verified bitmap
// with zero mismatches before being pasted in here - treat it as exact, not
// as something to casually hand-edit.
// XBM format: 8 pixels/byte, bit0 = leftmost pixel of each byte, 16 bytes
// per 128px row, 64 rows, 1024 bytes total.
// ============================================================================
static const uint8_t DOG_FINE_XBM[1024] PROGMEM = {
  0x00, 0x00, 0x00, 0x00, 0x00, 0x00, 0x00, 0x07, 0x00, 0x00, 0x00, 0x00, 0x00, 0x00, 0x00, 0x00,
  0x00, 0x00, 0x00, 0x00, 0x00, 0x00, 0xFC, 0x07, 0x00, 0x00, 0x00, 0x00, 0x00, 0x00, 0x00, 0x00,
  0x00, 0x00, 0x00, 0x00, 0x00, 0xE0, 0xFF, 0x3F, 0x00, 0x00, 0x00, 0x00, 0x00, 0x00, 0x00, 0x00,
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  0x00, 0x00, 0xFE, 0x1F, 0x00, 0xFE, 0xF7, 0xFF, 0xFF, 0xFF, 0x00, 0xF0, 0xFF, 0x1F, 0x00, 0x00
};

// ============================================================================
// Idle / touch (PAT) screens
// ============================================================================

// The JS version applies a symmetric +/-1px bob by offsetting fillRect calls
// in a per-pixel loop. u8g2's drawXBMP takes unsigned coordinates, so a
// literal y=-1 would underflow to 65535 instead of shifting the image up -
// that's a real hazard, not a style choice, so the bob here is deliberately
// asymmetric (0 or +1, never negative) to stay well inside safe unsigned
// arithmetic. Cosmetically this is a slightly different wobble than the
// simulator's; functionally it's the safe choice for hardware.
static uint8_t idleBobOffset(uint32_t tick) {
  float phase = sinf((tick * 2.0f * PI) / 42.0f);
  return (phase > 0.15f) ? 1 : 0;
}

static void drawIdleFace(uint32_t tick) {
  uint8_t bob = idleBobOffset(tick);
  u8g2.setDrawColor(1);
  u8g2.drawXBMP(0, bob, DISPLAY_WIDTH, DISPLAY_HEIGHT, DOG_FINE_XBM);
}

// Erases the extracted neutral mouth/nose region back to solid "on", then
// draws a grin curve on top - high at the corners, dipping at the center.
// Coordinates ported directly from the verified drawSmile() in the
// simulator (cx=64, half-width=24, depth=9).
static void drawSmileOverlay() {
  u8g2.setDrawColor(1);
  u8g2.drawBox(47, 43, 90 - 47, 63 - 43); // erase old mouth: (46,42)-(90,63) exclusive
  u8g2.setDrawColor(0);
  for (int16_t x = 41; x <= 87; x++) {
    float t = (x - 64) / 24.0f;
    float centerY = 50.0f + 9.0f * (1.0f - t * t);
    int16_t yTop = (int16_t)lroundf(centerY - 2.2f);
    int16_t yBot = (int16_t)lroundf(centerY + 2.2f);
    if (yTop < 0) yTop = 0;
    u8g2.drawVLine(x, yTop, (yBot - yTop) + 1);
  }
  u8g2.setDrawColor(1);
}

static void drawPatScreen(uint32_t tick) {
  drawIdleFace(tick);
  drawSmileOverlay();
  // small sparkle blips, ported from the simulator's PAT overlay
  int16_t sparkles[3][2] = {{-34, 6}, {34, 2}, {0, -32}};
  for (uint8_t i = 0; i < 3; i++) {
    uint32_t p = (tick + i * 7) % 20;
    int16_t cx = 64 + sparkles[i][0];
    int16_t cy = 34 + sparkles[i][1] - (int16_t)(p * 0.7f);
    if (cy < -3 || cy > 66) continue; // fully offscreen, skip
    u8g2.drawBox(cx - 2, cy - 2, 4, 4);
  }
}

// ============================================================================
// Clock / Pomodoro / Weather / Settings - retro style, locked per final
// design (cell=4 hero text, cell=1 labels; same numbers as the simulator's
// "retro" branch).
// ============================================================================

static void drawClockScreen(const DisplayData& d) {
  static const char* DAYS[7] = {"SUN", "MON", "TUE", "WED", "THU", "FRI", "SAT"};
  char timeStr[8];
  snprintf(timeStr, sizeof(timeStr), "%02u:%02u", d.hours, d.minutes);
  char dateStr[16];
  snprintf(dateStr, sizeof(dateStr), "%s %02u IST", DAYS[d.weekday % 7], d.dayOfMonth);

  const uint8_t cell = 4;
  const int16_t heroY = 10;
  drawPixelText(timeStr, 64, heroY, cell, ALIGN_CENTER);
  int16_t heroBottom = heroY + 7 * cell;
  drawPixelText(dateStr, 64, heroBottom + 6, 1, ALIGN_CENTER);

  u8g2.setDrawColor(1);
  u8g2.drawBox(4, 4, 6, 1);
  u8g2.drawBox(4, 4, 1, 6);
  u8g2.drawBox(118, 4, 6, 1);
  u8g2.drawBox(123, 4, 1, 6);
}

static void drawPomodoroScreen(const DisplayData& d) {
  const char* label = d.pomodoroIsWork ? "FOCUS" : "BREAK";
  char cycleStr[6];
  snprintf(cycleStr, sizeof(cycleStr), "%u/4", d.pomodoroCycle);
  char timeStr[8];
  snprintf(timeStr, sizeof(timeStr), "%02u:%02u", d.pomodoroSecondsLeft / 60, d.pomodoroSecondsLeft % 60);

  // Uses the real length of the current phase (25 min work, 5 min short
  // break, or 15 min long break) rather than assuming every phase is 25
  // minutes — the old hardcoded version made breaks show an almost-empty
  // bar for their entire duration.
  float progress = 0.0f;
  if (d.pomodoroTotalSeconds > 0) {
    progress = 1.0f - (float)d.pomodoroSecondsLeft / (float)d.pomodoroTotalSeconds;
  }
  if (progress < 0) progress = 0;
  if (progress > 1) progress = 1;

  drawPixelText(label, 6, 4, 1, ALIGN_LEFT);
  drawPixelText(cycleStr, 122, 4, 1, ALIGN_RIGHT);

  const uint8_t cell = 4;
  const int16_t heroY = 18;
  drawPixelText(timeStr, 64, heroY, cell, ALIGN_CENTER);
  int16_t heroBottom = heroY + 7 * cell;

  u8g2.setDrawColor(1);
  u8g2.drawFrame(9, heroBottom + 6, 110, 6);
  int16_t fillW = (int16_t)(110 * progress);
  if (fillW > 108) fillW = 108;
  if (fillW > 0) u8g2.drawBox(10, heroBottom + 7, fillW, 4);
}

static void drawWeatherScreen(const DisplayData& d) {
  const uint8_t cell = 4;
  char tempStr[5];
  snprintf(tempStr, sizeof(tempStr), "%d", d.tempC);
  int16_t tempW = drawPixelText(tempStr, 6, 6, cell, ALIGN_LEFT);
  drawDegree(6 + tempW + 2, 6, cell);

  int16_t heroBottom = 6 + 7 * cell;
  char descUpper[12];
  uint8_t i = 0;
  for (; d.weatherDesc[i] && i < sizeof(descUpper) - 1; i++) descUpper[i] = toupper(d.weatherDesc[i]);
  descUpper[i] = '\0';
  drawPixelText(descUpper, 6, heroBottom + 4, 1, ALIGN_LEFT);

  char humStr[12];
  snprintf(humStr, sizeof(humStr), "HUM %u%%", d.humidityPct);
  drawPixelText(humStr, 6, heroBottom + 14, 1, ALIGN_LEFT);

  char windStr[14];
  snprintf(windStr, sizeof(windStr), "WIND %uKM/H", d.windKmh);
  drawPixelText(windStr, 6, heroBottom + 24, 1, ALIGN_LEFT);

  // pixel-block sun icon, top right
  const int16_t sx = 96, sy = 18;
  u8g2.setDrawColor(1);
  u8g2.drawBox(sx - 1, sy - 1, 4, 4);
  for (uint8_t r = 0; r < 8; r++) {
    float a = (r / 8.0f) * 2.0f * PI + (d.animTick / 30.0f);
    int16_t px = sx + (int16_t)lroundf(cosf(a) * 9);
    int16_t py = sy + (int16_t)lroundf(sinf(a) * 9);
    u8g2.drawBox(px, py, 2, 2);
  }
}

static void drawSettingsScreen(const DisplayData& d) {
  static const char* ITEMS[4] = {"BRIGHTNESS", "WI-FI", "VOLUME", "TIMEZONE"};
  drawPixelText("SETTINGS", 6, 3, 1, ALIGN_LEFT);
  u8g2.setDrawColor(1);
  u8g2.drawBox(4, 12, 120, 1);

  for (uint8_t i = 0; i < 4; i++) {
    int16_t y = 17 + i * 11;
    if (i == d.settingsSelectedIndex) {
      u8g2.setDrawColor(1);
      u8g2.drawBox(4, y - 1, 120, 9);
      u8g2.setDrawColor(0);
      drawPixelText(ITEMS[i], 8, y, 1, ALIGN_LEFT);
      u8g2.setDrawColor(1);
    } else {
      drawPixelText(ITEMS[i], 8, y, 1, ALIGN_LEFT);
    }
  }
}

// ============================================================================
// Public API
// ============================================================================

void display_init() {
  Wire.begin(DISPLAY_I2C_SDA_PIN, DISPLAY_I2C_SCL_PIN);
  Wire.setClock(DISPLAY_I2C_CLOCK_HZ);
  u8g2.setI2CAddress(DISPLAY_I2C_ADDRESS << 1); // u8g2 wants the 8-bit address
  u8g2.begin();
  u8g2.clearBuffer();
  u8g2.sendBuffer();
}

void display_render(const DisplayData& d) {
  u8g2.clearBuffer();
  u8g2.setDrawColor(1);

  switch (d.screen) {
    case ScreenID::IDLE:     drawIdleFace(d.animTick); break;
    case ScreenID::PAT:      drawPatScreen(d.animTick); break;
    case ScreenID::CLOCK:    drawClockScreen(d); break;
    case ScreenID::POMODORO: drawPomodoroScreen(d); break;
    case ScreenID::WEATHER:  drawWeatherScreen(d); break;
    case ScreenID::SETTINGS: drawSettingsScreen(d); break;
    default:                 drawIdleFace(d.animTick); break; // LISTENING/SPEAKING land here until Phase 2
  }

  u8g2.sendBuffer();
}
