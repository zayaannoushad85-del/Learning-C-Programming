[Variables]

Format=H
Hidden=0
Hidden2=1
ScrollMouseIncrement=0.01
Color1=255,255,255
Player=WMP
--------------------------------------------------------------
--------------------------------------------------------------

Latitude=40.45635216
Longitude=-3.67870331

APIKey=21d8a80b3d6b444998a80b3d6b1449d3

URL=https://api.weather.com/v3/aggcommon/v3-wx-observations-current;v3-wx-forecast-daily-15day;v3alertsHeadlines;v3-location-point;v3-wx-forecast-hourly-12hour?format=json&geocode=#Latitude#,#Longitude#&units=#Units#&language=#Language#&apiKey=#APIKey#


LanginUse=Spanish

Language=es-ES

Units=m


TimeFormat=

SpeedUnit=Kmh
PressureUnit=Mb
VisibilityUnit=Km



SizeValue=0.26

--------------------------------------------------------------
--------------------------------------------------------------
